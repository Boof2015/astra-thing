## meta-astra-thing/conf/distro/astra-thing-release.conf
```bitbake
require conf/distro/astra-thing.conf
DISTRO = "astra-thing-release"
DISTRO_VERSION = "0.3.0"
ASTRA_RELEASE = "1"
ASTRA_RELEASE_BUILD ??= "unset"
EXTRA_IMAGE_FEATURES:remove = "debug-tweaks empty-root-password allow-empty-password allow-root-login tools-debug serial-autologin-root ssh-server-openssh"
INHERIT += "create-spdx"
COPY_LIC_MANIFEST = "1"
COPY_LIC_DIRS = "1"
```

## meta-astra-thing/conf/distro/astra-thing.conf
```bitbake
require conf/distro/superbird-kiosk.conf
DISTRO = "astra-thing"
DISTRO_NAME = "Astra Thing"
DISTRO_VERSION = "0.2.0"
SUPERBIRD_HOSTNAME = "astra-thing"
SUPERBIRD_MDNS_SERVICE_NAME = "Astra Thing"
SUPERBIRD_USB_GADGET_NAME = "astra-thing"
SUPERBIRD_USB_GADGET_MANUFACTURER = "Astra"
SUPERBIRD_USB_GADGET_PRODUCT = "Astra Thing"
SUPERBIRD_BOOT_LOGO_NAME = "logo.bmp"
SUPERBIRD_WESTON_SPLASH_IMAGE = "splash.png"
CHROMIUM_KIOSK_URL = "http://127.0.0.1:8080"
```

## meta-astra-thing/conf/layer.conf
```bitbake
BBPATH .= ":${LAYERDIR}"
BBFILES += "${LAYERDIR}/recipes-*/*/*.bb ${LAYERDIR}/recipes-*/*/*.bbappend"
BBFILE_COLLECTIONS += "astra-thing"
BBFILE_PATTERN_astra-thing = "^${LAYERDIR}/"
BBFILE_PRIORITY_astra-thing = "30"
LAYERSERIES_COMPAT_astra-thing = "wrynose"
LAYERDEPENDS_astra-thing = "core superbird superbird-kiosk-example"
ASTRA_THING_ROOT := "${LAYERDIR}/.."
```
